## Config.in
```kconfig
# Name set in external.desc
source "$BR2_EXTERNAL_CUSTOM_PATH/package/mpu6050/Config.in"
```

## package/mpu6050/Config.in
```kconfig
config BR2_PACKAGE_MPU6050_MODULE
        bool "mpu6050"
        depends on BR2_LINUX_KERNEL
        help
                Custom driver for MPU6050 gryro-accelerometer
```
